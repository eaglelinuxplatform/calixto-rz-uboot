## board/calixto/rzg2l-optima/Kconfig
```kconfig
if TARGET_RZG2L_OPTIMA

config SYS_SOC
	default "rmobile"

config SYS_BOARD
	default "rzg2l-optima"

config SYS_VENDOR
	default "calixto"

config SYS_CONFIG_NAME
	default "rzg2l-optima"

endif
```

## board/calixto/rzg2l-versa/Kconfig
```kconfig
if TARGET_RZG2L_VERSA

config SYS_SOC
	default "rmobile"

config SYS_BOARD
	default "rzg2l-versa"

config SYS_VENDOR
	default "calixto"

config SYS_CONFIG_NAME
	default "rzg2l-versa"

endif
```

## board/calixto/rzv2l-optima/Kconfig
```kconfig
if TARGET_RZV2L_OPTIMA

config SYS_SOC
	default "rmobile"

config SYS_BOARD
	default "rzv2l-optima"

config SYS_VENDOR
	default "calixto"

config SYS_CONFIG_NAME
	default "rzv2l-optima"

endif
```

## board/calixto/rzv2l-versa/Kconfig
```kconfig
if TARGET_RZV2L_VERSA

config SYS_SOC
	default "rmobile"

config SYS_BOARD
	default "rzv2l-versa"

config SYS_VENDOR
	default "calixto"

config SYS_CONFIG_NAME
	default "rzv2l-versa"

endif
```

## configs/rzv2l_calixto_optima_2GB_defconfig
```kconfig
CONFIG_ARM=y
CONFIG_ARCH_CPU_INIT=y
CONFIG_ARCH_RMOBILE=y
CONFIG_SYS_TEXT_BASE=0x50000000
CONFIG_ENV_SIZE=0x2000
CONFIG_ENV_OFFSET=0x760000
CONFIG_ENV_SECT_SIZE=0x1000
CONFIG_DM_GPIO=y
CONFIG_DEFAULT_DEVICE_TREE="rzv2l-calixto-optima"
CONFIG_RCAR_GEN3=y
CONFIG_R9A07G054L=y
CONFIG_TARGET_RZV2L_OPTIMA=y
# CONFIG_SPL is not set
CONFIG_FIT=y
CONFIG_SUPPORT_RAW_INITRD=y
CONFIG_DEFAULT_FDT_FILE="rzv2l-calixto-optima.dtb"
CONFIG_CALIXTO_DDR4_2GB=y
CONFIG_BOARD_LATE_INIT=y
CONFIG_HUSH_PARSER=y
CONFIG_CMD_BOOTZ=y
CONFIG_CMD_GPIO=y
CONFIG_CMD_I2C=y
CONFIG_CMD_MMC=y
CONFIG_CMD_PCI=y
CONFIG_CMD_SPI=y
CONFIG_CMD_USB=y
CONFIG_CMD_WDT=y
CONFIG_CMD_DHCP=y
CONFIG_CMD_MII=y
CONFIG_CMD_PING=y
CONFIG_CMD_EXT2=y
CONFIG_CMD_EXT4=y
CONFIG_CMD_EXT4_WRITE=y
CONFIG_CMD_FAT=y
CONFIG_CMD_FS_GENERIC=y
CONFIG_OF_CONTROL=y
CONFIG_ENV_OVERWRITE=y
CONFIG_ENV_IS_IN_SPI_FLASH=y
CONFIG_SYS_RELOC_GD_ENV_ADDR=y
CONFIG_VERSION_VARIABLE=y
CONFIG_REGMAP=y
CONFIG_SYSCON=y
CONFIG_CLK=y
CONFIG_CLK_RENESAS=y
CONFIG_CLK_R9A07G054L=y
CONFIG_RCAR_GPIO=y
CONFIG_RZG2L_GPIO=y
CONFIG_DM_I2C=y
CONFIG_SYS_I2C_RCAR_IIC=y
CONFIG_SYS_I2C_RZG2L_RIIC=y
CONFIG_SH_SDHI=y
CONFIG_DM_SPI_FLASH=y
CONFIG_SPI_FLASH_STMICRO=y
CONFIG_SPI_FLASH_WINBOND=y
CONFIG_BITBANGMII=y
CONFIG_PHY_MICREL=y
CONFIG_PHY_MICREL_KSZ90X1=y
CONFIG_DM_ETH=y
CONFIG_RENESAS_RAVB=y
CONFIG_PCI=y
CONFIG_PCI_RCAR_GEN3=y
CONFIG_PINCTRL_PFC_RZG2L=y
CONFIG_DM_REGULATOR=y
CONFIG_DM_REGULATOR_FIXED=y
CONFIG_DM_REGULATOR_GPIO=y
CONFIG_SCIF_CONSOLE=y
CONFIG_SPI=y
CONFIG_DM_SPI=y
CONFIG_RENESAS_RPC_SPI=y
CONFIG_TEE=y
CONFIG_OPTEE=y
CONFIG_USB=y
CONFIG_USB_XHCI_HCD=y
CONFIG_USB_EHCI_HCD=y
CONFIG_USB_EHCI_GENERIC=y
CONFIG_USB_STORAGE=y
CONFIG_WDT=y
CONFIG_RENESAS_RZG2LWDT=y
CONFIG_OF_LIBFDT_OVERLAY=y
```
